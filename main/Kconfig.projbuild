## main/Kconfig.projbuild
```kconfig
menu "Application Configuration"

	config GPIO_RANGE_MAX
		int
		default 33 if IDF_TARGET_ESP32
		default 46 if IDF_TARGET_ESP32S2
		default 48 if IDF_TARGET_ESP32S3
		default 18 if IDF_TARGET_ESP32C2
		default 19 if IDF_TARGET_ESP32C3
		default 30 if IDF_TARGET_ESP32C6

	menu "WiFi Setting"

		config ESP_WIFI_SSID
			string "WiFi SSID"
			default "myssid"
			help
				SSID (network name) for the example to connect to.

		config ESP_WIFI_PASSWORD
			string "WiFi Password"
			default "mypassword"
			help
				WiFi password (WPA or WPA2) for the example to use.

		config ESP_MAXIMUM_RETRY
			int "Maximum retry"
			default 5
			help
				Set the Maximum retry to avoid station reconnecting to the AP unlimited when the AP is really inexistent.

		config UDP_PORT
			int "UDP Port"
			range 1024 65535
			default 49876
			help
				Port to send data output to

	endmenu

	menu "Device Setting"

		config LED_CONNECTED_GPIO
			int "GPIO number to connected LED"
			range -1 GPIO_RANGE_MAX
			default -1
			help
				GPIO number (IOxx) to status LED.

		config LED_TRIGGER_GPIO
			int "GPIO number to trigger LED"
			range -1 GPIO_RANGE_MAX
			default -1
			help
				GPIO number (IOxx) to status LED.
	endmenu

endmenu
```
